## Kconfig
```kconfig
config ZMK_EXT_POWER_SMART_IDLE
    bool "Smart ext-power idle - skip idle timeout when USB is connected"
    depends on ZMK_EXT_POWER
    depends on USB_DEVICE_STACK
    default n

config ZMK_EXT_POWER_SMART_IDLE_BATTERY_BRT
    int "Max RGB brightness (0-100) when on battery"
    depends on ZMK_EXT_POWER_SMART_IDLE
    depends on ZMK_RGB_UNDERGLOW
    default 20
    range 0 100
    help
      When USB is disconnected, RGB brightness is clamped to this value.
      The original brightness is restored when USB is reconnected.
      This only modifies runtime state - no flash writes occur.

config ZMK_EXT_POWER_SMART_IDLE_BATTERY_CUTOFF
    int "Battery percentage at which LEDs turn off (0 to disable)"
    depends on ZMK_EXT_POWER_SMART_IDLE
    depends on ZMK_BATTERY
    default 0
    range 0 100
    help
      When on battery and the charge level drops to or below this value,
      ext-power is turned off to preserve remaining battery for typing.
      Power is restored when USB is connected or battery rises above
      this threshold. Set to 0 to disable.

config ZMK_EXT_POWER_SMART_IDLE_USB_TIMEOUT_S
    int "Seconds of idle on USB before turning ext-power off (0 to disable)"
    depends on ZMK_EXT_POWER_SMART_IDLE
    default 0
    help
      When USB is connected and ZMK transitions to its IDLE activity state,
      schedule an auto-off after this many seconds. Cancelled if activity
      returns to ACTIVE or USB is disconnected before the timer fires.
      Set to 0 to keep ext-power on indefinitely while USB is connected
      (the original smart-idle behavior). Restored to ON when activity
      returns to ACTIVE.

config ZMK_EXT_POWER_SMART_IDLE_FADE_MS
    int "Milliseconds to fade RGB brightness to zero before any auto-off"
    depends on ZMK_EXT_POWER_SMART_IDLE
    depends on ZMK_RGB_UNDERGLOW
    default 2000
    range 0 10000
    help
      When any auto-off event fires (on-battery idle, on-USB idle timeout,
      or battery cutoff), linearly fade RGB brightness from its current
      value down to 0 over this many milliseconds, then cut the ext-power
      MOSFET. Only modifies runtime brightness state - no flash writes
      occur, and the pre-fade brightness is restored on wake. Set to 0 to
      disable the fade and cut ext-power instantly (the original behavior).

config ZMK_EXT_POWER_SMART_IDLE_SYNC_HALVES
    bool "Share smart-idle state across split halves (requires fork)"
    depends on ZMK_EXT_POWER_SMART_IDLE
    depends on ZMK_SPLIT_BLE_SMART_IDLE_SYNC
    default n
    help
      Cross-half coordination for split keyboards. With this option on,
      each half broadcasts its activity state and battery-cutoff state
      to the other half so that:
        * If EITHER half is ACTIVE, both halves treat themselves as
          active for the idle fade-off decision. Idle fade only fires
          when BOTH halves are idle.
        * If EITHER half drops below the battery cutoff threshold, both
          halves fade their LEDs off (preserves remaining typing time
          for the lower cell). Restores when its own local battery is
          back above cutoff or USB is connected.
      Requires the matching ZMK_SPLIT_BLE_SMART_IDLE_SYNC option in the
      ZMK fork at https://github.com/Frosthaven/zmk (branch
      v0.3-peripheral-charging-bit). On stock ZMK this option is hidden
      and each half runs independently as before.

config ZMK_EXT_POWER_SMART_IDLE_ENFORCE_BRT_CAP
    bool "Continuously enforce the on-battery brightness cap (requires fork)"
    depends on ZMK_EXT_POWER_SMART_IDLE
    depends on ZMK_RGB_UNDERGLOW
    depends on ZMK_RGB_UNDERGLOW_RUNTIME_CAP
    default n
    help
      Enforces BATTERY_BRT as a soft cap at the LED render layer (via
      zmk_rgb_underglow_set_runtime_max_brightness) while on battery,
      and lifts the cap when USB is connected. The user's pressed-up
      brightness still accumulates in state.color.b all the way to
      BRT_MAX and persists to NVS at its real value - only the visual
      output is clamped. Without this option, the cap is applied
      one-shot at the USB->battery transition by mutating state.color.b
      (which causes NVS to capture the clamped value and the press-up
      hotkey to bypass the cap until the next transition). Requires
      the matching ZMK_RGB_UNDERGLOW_RUNTIME_CAP option in the ZMK
      fork at https://github.com/Frosthaven/zmk (branch
      v0.3-peripheral-charging-bit). On stock ZMK this option is
      hidden and the legacy one-shot mutation path is used.
```
